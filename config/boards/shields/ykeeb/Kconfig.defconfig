## config/boards/shields/ykeeb/Kconfig.defconfig
```kconfig
if SHIELD_YKEEB_LEFT

    config ZMK_KEYBOARD_NAME
        default "WhyBoard"

    config ZMK_SPLIT_ROLE_CENTRAL
        default y

endif

if SHIELD_YKEEB_LEFT || SHIELD_YKEEB_RIGHT

    config ZMK_SPLIT
        default y

    config ZMK_SPLIT_BLE_CENTRAL_BATTERY_LEVEL_PROXY
        default y

    config ZMK_SPLIT_BLE_CENTRAL_BATTERY_LEVEL_FETCHING
        default y

endif
```

## config/west.yml
```yaml
manifest:
  remotes:
    - name: zmkfirmware
      url-base: https://github.com/zmkfirmware
    - name: urob
      url-base: https://github.com/urob
  projects:
    - name: zmk
      remote: zmkfirmware
      revision: main
      import: app/west.yml
    # LS second remote for the zmk helpers
    - name: zmk-helpers
      remote: urob
      revision: main
  self:
    path: config
```
